## conf/distro/game-pi.conf
```bitbake
# See also: https://www.yoctoproject.org/docs/1.6/dev-manual/dev-manual.html#creating-your-own-distribution
# See also: meta-poky/conf/distro/poky.conf
# See also: meta/conf/distro/defaultsetup.conf (used when distro has no name)

DISTRO_NAME = "game-pi"
DISTRO_VERSION = "0.1"

# Software support (features) in distribution (see also: IMAGE_FEATURES).
DISTRO_FEATURES = "x11 x11-base"

# List of distro-specific packages to add to all images.
#DISTRO_EXTRA_RDEPENDS =

# List of distro-specific packages to add to all images if the packages exist.
#DISTRO_EXTRA_RRECOMMENDS =

# Specifies the GNU standard C library (libc) variant to use during the build process ("eglibc" or "uclibc").
#TCLIBC =
```

## conf/layer.conf
```bitbake
# We have a conf and classes directory, add to BBPATH
BBPATH .= ":${LAYERDIR}"

# We have recipes-* directories, add to BBFILES
BBFILES += "${LAYERDIR}/recipes-*/*/*.bb \
            ${LAYERDIR}/recipes-*/*/*.bbappend"

BBFILE_COLLECTIONS += "meta-game-pi"
BBFILE_PATTERN_meta-game-pi = "^${LAYERDIR}/"
BBFILE_PRIORITY_meta-game-pi = "6"
LAYERSERIES_COMPAT_meta-game-pi = "sumo"
```
